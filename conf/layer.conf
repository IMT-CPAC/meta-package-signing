## conf/layer.conf
```bitbake
# We have a conf and classes directory, add to BBPATH
BBPATH .= ":${LAYERDIR}"

# We have a recipes-* directories, add to BBFILES
BBFILES += "${LAYERDIR}/recipes-*/*/*.bb \
    ${LAYERDIR}/recipes-*/*/*.bbappend"

BBFILE_COLLECTIONS += "meta-signeddeb"
BBFILE_PATTERN_meta-signeddeb = "^${LAYERDIR}/"
BBFILE_PRIORITY_meta-signeddeb = "5"
```
